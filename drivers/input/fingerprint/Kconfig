## drivers/input/fingerprint/Kconfig
```kconfig
config INPUT_FINGERPRINT
	tristate "Fingerprint driver support"
	help
	  Say Y here to enable fingerprint driver support!

source "drivers/input/fingerprint/goodix_fp/Kconfig"
source "drivers/input/fingerprint/betterlife_fp/Kconfig"
```
